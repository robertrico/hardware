/*
 * REGISTER MODULE TEST (74LS373 + 74LS245 + 74LS121)
 * ===================================================
 * 
 * PURPOSE:
 * Tests a register module that uses:
 * - 74LS245: Bus transceiver for bidirectional data transfer
 * - 74LS373: Octal latch for data storage
 * - 74LS121: Monostable multivibrator for generating latch pulse
 * - Additional logic gates (NAND, NOR, Inverter) for control (not directly tested)
 * 
 * THEORY OF OPERATION:
 * This module represents a general-purpose register in the CPU. The key innovation
 * is that the latch pulse is generated by discrete logic (74LS121) rather than
 * software timing. This ensures consistent, hardware-controlled timing.
 * 
 * CONTROL WORD (3 bits output simultaneously):
 * The Arduino outputs a 3-bit control word. The 121 monitors these signals
 * and generates a latch pulse when they change to a LOAD state.
 * 
 * D1:D4:D5 Control States:
 * - [0,0,0]: Idle state, 245 disabled
 * - [1,1,0]: Load data into register (121 auto-generates pulse)
 * - [0,0,1]: Read data from register
 * - [1,0,0]: Reserved/unused
 * - [0,1,0]: Reserved/unused
 * 
 * HARDWARE GATE LOGIC (automatic):
 * - 121 triggers on control word transition to LOAD state
 * - 245 ~OE = !(D4 | D5)  [NOR gate - enabled when either HIGH]
 * - 245 DIR = !D5         [Inverter - HIGH=A→B (Arduino writes), LOW=B→A (Arduino reads)]
 * - 373 ~OE = D5          [Direct - enabled when D5 is LOW]
 * 
 * BUS DIRECTION CLARIFICATION:
 * - LOAD operation: Arduino drives bus → 245 accepts input (DIR=HIGH, A→B)
 * - READ operation: 245/373 drive bus → Arduino must be input (DIR=LOW, B→A)
 * - Arduino bus direction MUST match 245 direction to avoid contention!
 * 
 * CRITICAL WIRING TABLE:
 * ====================================================================================
 * Arduino Pin | Signal     | Function
 * ------------|------------|-------------------------------------------------------
 * D1 (PD1)    | CTRL_BIT0  | Control word bit 0 (part of LOAD trigger)
 * D4 (PD4)    | CTRL_BIT1  | Control word bit 1 (REG_LOAD signal)
 * D5 (PD5)    | CTRL_BIT2  | Control word bit 2 (REG_OUT signal)
 * D6-D13      | Data Bus   | 8-bit data (reversed: D13=bit0, D6=bit7)
 * ====================================================================================
 * 
 * 121 TRIGGER LOGIC:
 * The 121 monitors D1 & D4 and triggers a pulse when transitioning to [1,1,x]
 * This provides automatic latching when LOAD operation is selected.
 * 
 * GATE-CONTROLLED SIGNALS:
 * - 245 pin 19 (~OE) = Output of NOR(D4, D5)
 * - 245 pin 1 (DIR) = Output of NOT(D5)
 * - 373 pin 1 (~OE) = D5 (when LOW, 373 outputs enabled)
 * 
 * 74LS245 CONNECTIONS:
 * ====================================================================================
 * 245 Pin | Connection     | Purpose
 * --------|----------------|--------------------------------------------------
 * 1       | REG_LOAD (D4)  | DIR - Direction control
 * 19      | REG_OUT (D5)   | ~OE - Output Enable (active LOW)
 * 2-9     | Arduino D6-D13 | A0-A7 - A-side (Arduino side)
 * 11-18   | 373 D inputs   | B0-B7 - B-side (Register side)
 * 10      | GND            | Ground
 * 20      | 5V             | VCC
 * ====================================================================================
 * 
 * 74LS373 CONNECTIONS:
 * ====================================================================================
 * 373 Pin | Connection     | Purpose
 * --------|----------------|--------------------------------------------------
 * 11      | 121 Output     | LE - Latch Enable (pulse from 121)
 * 1       | Logic Gates    | ~OE - Output Enable (controlled by logic)
 * 3,4,7,8,13,14,17,18 | 245 B-side | D0-D7 - Data inputs
 * 2,5,6,9,12,15,16,19 | 245 B-side | Q0-Q7 - Data outputs (same nets)
 * 10      | GND            | Ground
 * 20      | 5V             | VCC
 * ====================================================================================
 * 
 * 74LS121 CONNECTIONS:
 * ====================================================================================
 * 121 Pin | Connection     | Purpose
 * --------|----------------|--------------------------------------------------
 * 3       | PULSE_REQ (D1) | A1 - Trigger input (rising edge)
 * 4       | 5V             | A2 - Tied HIGH
 * 5       | GND            | B - Tied LOW for positive edge trigger
 * 6       | Output to 373  | Q - Pulse output to 373 LE
 * 10,11   | RC Network     | Timing components (sets pulse width)
 * 7       | GND            | Ground
 * 14      | 5V             | VCC
 * ====================================================================================
 * 
 * PULSE TIMING:
 * The 121 generates a pulse width determined by the RC network.
 * Typical values: R=10kΩ, C=100pF gives ~1µs pulse
 * This is plenty for the 373's ~30ns hold time requirement
 */

#include "test_register.h"
#include "test_common.h"
#include <avr/io.h>
#include <util/delay.h>
#include <stdbool.h>

// Control signal definitions (3-bit control word)
#define CTRL_BIT0       PD1  // D1 -> Control word bit 0
#define CTRL_BIT1       PD4  // D4 -> Control word bit 1 (LOAD)
#define CTRL_BIT2       PD5  // D5 -> Control word bit 2 (OUT)

// Control word masks for readability
#define CTRL_IDLE       0x00  // [0,0,0] - All disabled
#define CTRL_LOAD       0x03  // [1,1,0] - Load data (D1=1, D4=1, D5=0)
#define CTRL_READ       0x04  // [0,0,1] - Read data (D1=0, D4=0, D5=1)

// Timing configuration
// At 250kHz system clock: 4µs per clock cycle
// We use small delays between operations for hardware settling
// The 121 generates ~1µs pulses, so 10µs is plenty of margin
#define OPERATION_DELAY_US    10   // 10µs between operations

// Test patterns - same comprehensive set as other tests
static const uint8_t test_patterns[] = {
    0x00,   // All zeros
    0xFF,   // All ones
    0xAA,   // Alternating 10101010
    0x55,   // Alternating 01010101
    0x0F,   // Lower nibble
    0xF0,   // Upper nibble
    0x81,   // Edge bits
    0x42,   // Specific pattern
    0x3C,   // Center block
    0xC3,   // Inverted center
    // Walking ones
    0x01, 0x02, 0x04, 0x08, 0x10, 0x20, 0x40, 0x80,
    // Walking zeros
    0xFE, 0xFD, 0xFB, 0xF7, 0xEF, 0xDF, 0xBF, 0x7F
};

/*
 * set_control_word() - Atomically set the 3-bit control word
 * 
 * Clears old control bits and sets new ones in a single write to PORTD.
 * This ensures clean transitions for the 74LS121 trigger detection.
 */
static void set_control_word(uint8_t control) {
    uint8_t portd_value = PORTD;
    
    // Clear all control bits
    portd_value &= ~((1 << CTRL_BIT0) | (1 << CTRL_BIT1) | (1 << CTRL_BIT2));
    
    // Set new control bits
    if (control & 0x01) portd_value |= (1 << CTRL_BIT0);  // D1
    if (control & 0x02) portd_value |= (1 << CTRL_BIT1);  // D4
    if (control & 0x04) portd_value |= (1 << CTRL_BIT2);  // D5
    
    // Atomic write
    PORTD = portd_value;
}
/*
 * init_pins() - Initialize for safe operation
 * 
 * Initial state:
 * - Control word = [0,0,0] (idle)
 * - This makes 245 disabled via NOR gate
 * - Data bus high-Z
 */
static void init_pins(void) {
    // Initialize LEDs using common function
    init_leds();
    
    // Configure control pins as outputs
    DDRD |= (1 << CTRL_BIT0) | (1 << CTRL_BIT1) | (1 << CTRL_BIT2);
    
    // Safe initial state
    set_control_word(CTRL_IDLE);  // [0,0,0] - 245 disabled via NOR gate
    set_bus_as_input();            // Data bus high-Z
}

// Bus operations are now provided by test_common.h

/*
 * hardware_settle_delay() - Brief delay for hardware settling
 * 
 * Gives the hardware time to respond to control signal changes.
 * At 250kHz, this is about 2.5 clock cycles.
 */
static void hardware_settle_delay(void) {
    _delay_us(OPERATION_DELAY_US);
}


/*
 * test_register_pattern() - Test one pattern through the register
 * 
 * Emulates actual CPU operation where:
 * - T0: Data appears on bus (from memory/other register)
 * - T1: LOAD control word latches the data
 * - T2: IDLE (clear control word)
 * - T3: READ control word outputs data
 * - T4: IDLE (allows verification)
 * 
 * Control word changes mark phase boundaries.
 * Data bus setup happens between phases (simulating other components).
 */
static bool test_register_pattern(uint8_t pattern) {
    // Put data on bus
    set_bus_as_output();
    write_to_bus(pattern);
    set_control_word(CTRL_IDLE);  // [0,0,0] - Start clean
    hardware_settle_delay();       // 10µs settle
    
    // Trigger LOAD - 121 generates latch pulse automatically
    set_control_word(CTRL_LOAD);  // [1,1,0] - 121 detects edge
    hardware_settle_delay();       // 121 pulse ~1µs, wait 10µs
    
    // Release bus for reading
    set_control_word(CTRL_IDLE);  // [0,0,0]
    set_bus_as_input();           // Stop driving bus
    hardware_settle_delay();
    
    // Read data back from register
    set_control_word(CTRL_READ);  // [0,0,1] - 245/373 drive bus
    hardware_settle_delay();       // Let outputs stabilize
    
    // Sample the data
    uint8_t read_value = read_from_bus();
    set_control_word(CTRL_IDLE);  // [0,0,0] - Release bus
    
    hardware_settle_delay();

    // Debug output: show what we read
    set_bus_as_output();
    write_to_bus(read_value);
    hardware_settle_delay();

    // Verify results
    return (read_value == pattern);
}

/*
 * test_register_run() - Main test entry point
 * 
 * Tests the register module with ring counter timing emulation.
 * Each test pattern uses 5 phases (T0-T4) of the 16 available phases:
 * - T0: Data bus setup (simulating memory/register output)
 * - T1: LOAD control word (latch data into register)
 * - T2: IDLE (release bus)
 * - T3: READ control word (register outputs data)
 * - T4: IDLE (verify data)
 * 
 * Total time per test pattern: 5 phases × 16ms = 80ms
 * 
 * The 74LS121 generates hardware-controlled latch pulses when it
 * detects transitions to the LOAD state, ensuring consistent timing.
 * 
 * LED INDICATORS:
 * - Startup sequence: Yellow-Green-Red-Green-Yellow
 * - Yellow solid: Tests running
 * - Green solid: All patterns passed
 * - Red solid: One or more patterns failed
 */
void test_register_run(void) {
    init_pins();
    
    // Show startup sequence
    show_startup_sequence();
    
    // Start test execution (adds 500ms delay)
    start_test_execution();
    
    // Test all patterns with ring counter timing
    bool all_passed = true;
    uint8_t num_patterns = sizeof(test_patterns) / sizeof(test_patterns[0]);
    
    for (uint8_t i = 0; i < num_patterns; i++) {
        if (!test_register_pattern(test_patterns[i])) {
            all_passed = false;
            // Continue testing all patterns to identify which fail
        }
        // Each pattern takes 80ms (5 phases × 16ms)
    }
    
    // Show final result
    show_test_result(all_passed);
    
    // Halt
    while (1) {
        _delay_ms(100);
    }
}