#include <avr/io.h>
#include <avr/pgmspace.h>
#include <util/delay.h>
#include <string.h>
#include "registry.h"
#include "harness.h"
#include "uart.h"
#include "crc16.h"
#include "microcode_expect.h"

/* Microcode board: 2x AT28C64B (U9 = CW0-7 low byte, U15 = CW8-15 high
   byte) + U16 (IRB -> A4-A11) + U17 (T -> A0-A3). Pure combinational —
   no CLK on this board. Rig owns the whole address side.

   EEPROM address = {IRB[7:0], T[3:0]} = opcode*16 + T, 4096 rows;
   A12 -> GND and ~WE -> +5V on the board (2026-07-14 fix — verify the
   straps before blaming a chip).

   Two burns, both generated by docs/notes/microcode_gen.py:
     DIAG pair  (U9_diag.bin/U15_diag.bin): word = own address | inverted
                top address nibble — burn FIRST, full address-wiring proof.
     REAL pair  (U9.bin/U15.bin): the instruction table.
   Tests auto-detect which burn is seated from row 0 (DIAG=0xF000,
   REAL=0x600E) and pick expectations to match; `order` gives full
   per-address-line coverage only on the DIAG burn.

   Wiring note (strike-7 taps): sample CW9-15 at the FAR ends of their tap
   runs (the consumer-board ends), not at the EEPROM header — then every
   test in this file also proves the physical tap wires. CW0-8 sample at
   the control-word-bound header.
   Sampled lines: CW0 CW1 CW2 CW3 CW4 CW5 CW6 CW7 CW8 CW9=SA2 CW10=SA1
   CW11=SA0 CW12=END CW13=PC_UP CW14=PC_MAR_MUX CW15=HALT
   Driven lines: IRB0-7, T0-3 (coverage: every contract signal named). */

static hwpin_t P_IRB[8], P_T[4], P_CW[16];
static bool s_bound;
static uint8_t s_gen;

#define IMG_UNKNOWN 0
#define IMG_DIAG 1
#define IMG_REAL 2
static uint8_t s_img;

static const char cw_names_s0[] PROGMEM = "CW0";
static const char cw_names_s1[] PROGMEM = "CW1";
static const char cw_names_s2[] PROGMEM = "CW2";
static const char cw_names_s3[] PROGMEM = "CW3";
static const char cw_names_s4[] PROGMEM = "CW4";
static const char cw_names_s5[] PROGMEM = "CW5";
static const char cw_names_s6[] PROGMEM = "CW6";
static const char cw_names_s7[] PROGMEM = "CW7";
static const char cw_names_s8[] PROGMEM = "CW8";
static const char cw_names_s9[] PROGMEM = "CW9=SA2";
static const char cw_names_s10[] PROGMEM = "CW10=SA1";
static const char cw_names_s11[] PROGMEM = "CW11=SA0";
static const char cw_names_s12[] PROGMEM = "CW12=END";
static const char cw_names_s13[] PROGMEM = "CW13=PC_UP";
static const char cw_names_s14[] PROGMEM = "CW14=PC_MAR_MUX";
static const char cw_names_s15[] PROGMEM = "CW15=HALT";
static const char * const CW_NAMES[16] PROGMEM = { cw_names_s0, cw_names_s1, cw_names_s2, cw_names_s3, cw_names_s4, cw_names_s5, cw_names_s6, cw_names_s7, cw_names_s8, cw_names_s9, cw_names_s10, cw_names_s11, cw_names_s12, cw_names_s13, cw_names_s14, cw_names_s15 };

static bool bind1(const char *sig_P, hwpin_t *out) {
    char sig[24];                       /* sig_lookup wants RAM */
    strcpy_P(sig, sig_P);
    if (sig_lookup("microcode", sig, out)) return true;
    uart_putsP("BIND FAIL "); uart_puts(sig); uart_putsP("\r\n");
    test_check_bool(false, true, sig_P);
    return false;
}

static bool bind(void) {
    if (s_bound && s_gen == g_pin_gen) return true;
    s_bound = false;
    s_img = IMG_UNKNOWN;
    bool ok = true;
    static const char irb_names_s0[] PROGMEM = "IRB0";
static const char irb_names_s1[] PROGMEM = "IRB1";
static const char irb_names_s2[] PROGMEM = "IRB2";
static const char irb_names_s3[] PROGMEM = "IRB3";
static const char irb_names_s4[] PROGMEM = "IRB4";
static const char irb_names_s5[] PROGMEM = "IRB5";
static const char irb_names_s6[] PROGMEM = "IRB6";
static const char irb_names_s7[] PROGMEM = "IRB7";
static const char * const IRB_NAMES[8] PROGMEM = { irb_names_s0, irb_names_s1, irb_names_s2, irb_names_s3, irb_names_s4, irb_names_s5, irb_names_s6, irb_names_s7 };
    static const char t_names_s0[] PROGMEM = "T0";
static const char t_names_s1[] PROGMEM = "T1";
static const char t_names_s2[] PROGMEM = "T2";
static const char t_names_s3[] PROGMEM = "T3";
static const char * const T_NAMES[4] PROGMEM = { t_names_s0, t_names_s1, t_names_s2, t_names_s3 };
    for (uint8_t i = 0; i < 8; i++) ok &= bind1(PN(IRB_NAMES, i), &P_IRB[i]);
    for (uint8_t i = 0; i < 4; i++) ok &= bind1(PN(T_NAMES, i), &P_T[i]);
    for (uint8_t i = 0; i < 16; i++) ok &= bind1(PN(CW_NAMES, i), &P_CW[i]);
    if (!ok) return false;                  /* never drive a garbage pin */
    /* fast paths assume IRB on PORTK ascending and CW on PORTC(lo) +
       PORTL(hi) (bus_m_read's ports) — guard against pinmap moves */
    if (P_IRB[0].port != &PORTK || P_IRB[0].bit != 0 ||
        P_IRB[7].port != &PORTK || P_IRB[7].bit != 7) {
        test_check_bool(false, true, PSTR("IRB_on_PORTK_ascending"));
        return false;
    }
    if (P_CW[0].pinr != &PINC || P_CW[0].bit != 0 ||
        P_CW[8].pinr != &PINL || P_CW[8].bit != 0 ||
        P_CW[15].pinr != &PINL || P_CW[15].bit != 7) {
        test_check_bool(false, true, PSTR("CW_bus_on_PORTC_PORTL"));
        return false;
    }
    DDRK = 0xFF; PORTK = 0x00;              /* IRB = 0 */
    for (uint8_t i = 0; i < 4; i++) drv(&P_T[i], false);
    settle();
    s_bound = true;
    s_gen = g_pin_gen;
    return true;
}

static uint16_t mc_read(uint16_t row) {
    PORTK = (uint8_t)(row >> 4);            /* opcode -> A4-A11 */
    for (uint8_t i = 0; i < 4; i++)         /* T      -> A0-A3  */
        drv(&P_T[i], (row >> i) & 1);
    settle();
    return bus_m_read();                    /* CW0-15 off PORTC+PORTL */
}

/* what the seated burn should hold at `row` */
static uint16_t expected(uint16_t row) {
    if (s_img == IMG_DIAG) return MC_DIAG_WORD(row);
    return pgm_read_word(&MC_REAL_WORDS[row]);
}

static const char *img_name_P(void) {   /* returns a FLASH pointer */
    return s_img == IMG_DIAG ? PSTR("DIAG")
         : s_img == IMG_REAL ? PSTR("REAL") : PSTR("?");
}

/* A self-consistent diag word ([15:12] == ~[11:8]) names the row the
   EEPROMs ACTUALLY decoded — so a diag burn behind a stuck/swapped
   address line is still recognizable, and the fault localizes itself. */
static bool diag_like(uint16_t w) {
    return ((w >> 12) & 0xF) == ((uint8_t)~(w >> 8) & 0xF);
}

/* row-0 signature -> image type; prints what it saw */
static bool detect(void) {
    if (s_img != IMG_UNKNOWN) return true;
    uint16_t w = mc_read(0);
    if (w == MC_DIAG_ROW0) s_img = IMG_DIAG;
    else if (w == MC_REAL_ROW0) s_img = IMG_REAL;
    uart_putsP("     image: "); uart_puts_p(img_name_P());
    uart_putsP(" (row0=0x"); uart_puthex16(w); uart_putsP(")\r\n");
    return s_img != IMG_UNKNOWN;
}

void t_microcode_warmup(void) {
    test_begin(PSTR("microcode"), PSTR("warmup"));
    if (!bind()) { test_end(); return; }
    /* power-on readiness probe (same bench lesson as pc.warmup): loop a
       row-0 + row-0xFFF readback until it holds 4x in a row, print the
       settle time. Row 0 must match a known burn signature. */
    uint16_t waited_ms = 0;
    uint8_t streak = 0;
    while (streak < 4 && waited_ms < 10000) {
        s_img = IMG_UNKNOWN;
        uint16_t w0 = mc_read(0);
        bool ok = (w0 == MC_DIAG_ROW0 || w0 == MC_REAL_ROW0);
        if (ok) {
            s_img = (w0 == MC_DIAG_ROW0) ? IMG_DIAG : IMG_REAL;
            ok &= (mc_read(0xFFF) == expected(0xFFF));
            ok &= (mc_read(0) == w0);
        }
        if (ok) {
            streak++;
        } else {
            streak = 0;
            _delay_ms(100);
            waited_ms += 100;
        }
    }
    uart_putsP("     ready after ~");
    uart_putdec(waited_ms);
    uart_putsP("ms of settle, image: ");
    uart_puts_p(img_name_P());
    uart_putsP("\r\n");
    test_check_bool(streak == 4, true, PSTR("board_ready_within_10s"));
    test_end();
}

void t_microcode_presence(void) {
    test_begin(PSTR("microcode"), PSTR("presence"));
    if (!bind()) { test_end(); return; }
    /* chips in place: EEPROM outputs are always enabled on this board, so
       a floating CW line = missing/unseated chip (or dead tap run).
       Checked per byte so the FAIL names the socket. */
    (void)mc_read(0);
    bool u9_drives = true, u15_drives = true;
    for (uint8_t i = 0; i < 8; i++)  u9_drives  &= !floats(&P_CW[i]);
    for (uint8_t i = 8; i < 16; i++) u15_drives &= !floats(&P_CW[i]);
    test_check_bool(u9_drives, true, PSTR("U9_drives_CW0_7"));
    test_check_bool(u15_drives, true, PSTR("U15_drives_CW8_15"));
    /* row 0 must carry a known burn signature (also picks expectations
       for every later test) */
    test_check_bool(detect(), true, PSTR("row0_signature_known"));
    test_end();
}

void t_microcode_order(void) {
    test_begin(PSTR("microcode"), PSTR("order"));
    if (!bind()) { test_end(); return; }
    if (!detect()) {
        /* no signature — but diag-like content means a diag burn behind
           an ADDRESS fault. Walk the lines anyway and print what each
           one actually decodes; the fault names itself. */
        uint16_t w0 = mc_read(0);
        if (diag_like(w0)) {
            uart_putsP("     diag-like content: rig drove row 0x000, "
                      "chips decoded row 0x");
            uart_puthex16(w0 & 0x0FFF);
            uart_putsP(" — address line stuck/swapped\r\n");
            for (uint8_t k = 0; k < 12; k++) {
                uint16_t row = (uint16_t)1 << k;
                uint16_t got = mc_read(row);
                uart_putsP("     drove ");
                uart_puts(k < 4 ? "T" : "IRB");
                uart_putdec(k < 4 ? k : (uint8_t)(k - 4));
                uart_putsP(" (row 0x"); uart_puthex16(row);
                uart_putsP(") -> decoded row 0x");
                uart_puthex16(got & 0x0FFF);
                uart_puts(diag_like(got) ? "\r\n" : " (word corrupt too)\r\n");
            }
        }
        test_check_bool(false, true, PSTR("no_image"));
        test_end();
        return;
    }
    if (s_img == IMG_DIAG) {
        /* walking-1 through the 12 address lines: T0->A0 .. IRB7->A11.
           The diag word names the row the EEPROM actually decoded, so a
           mis-mapped line prints as the row it landed on. Retires the
           mirror-reversal bug class. */
        bool ok = true;
        for (uint8_t k = 0; k < 12; k++) {
            uint16_t row = (uint16_t)1 << k;
            uint16_t got = mc_read(row);
            if (got != MC_DIAG_WORD(row)) {
                ok = false;
                uart_putsP("     addr bit ");
                uart_putdec(k);
                uart_putsP(" (");
                uart_puts(k < 4 ? "T" : "IRB");
                uart_putdec(k < 4 ? k : (uint8_t)(k - 4));
                uart_putsP("): got 0x"); uart_puthex16(got);
                uart_putsP(" — decoded row 0x");
                uart_puthex16(got & 0x0FFF);
                uart_putsP("\r\n");
            }
        }
        test_check_bool(ok, true, PSTR("walking1_address_lines"));
        test_check_u16(mc_read(0x000), MC_DIAG_WORD(0x000), PSTR("all_low"));
        test_check_u16(mc_read(0xFFF), MC_DIAG_WORD(0xFFF), PSTR("all_high"));
    } else {
        /* REAL burn: walking-1 rows are nearly all safe-fill, so line
           order is only spot-checkable. Distinctive rows still catch a
           mirror (they'd land on 0x1000 fill). Full proof needs the
           DIAG burn — do it there. */
        uart_putsP("     REAL burn: distinctive-row check only; "
                  "full order proof needs the DIAG burn\r\n");
        static const uint16_t rows[] PROGMEM =
            {0x111, 0x121, 0x131, 0x211, 0x213, 0x411, 0x511, 0xFF1};
        for (uint8_t i = 0; i < 8; i++) {
            uint16_t row = pgm_read_word(&rows[i]);
            test_check_u16(mc_read(row), expected(row), PSTR("distinctive_row"));
        }
    }
    test_end();
}

void t_microcode_split(void) {
    test_begin(PSTR("microcode"), PSTR("split"));
    if (!bind()) { test_end(); return; }
    if (!detect()) { test_check_bool(false, true, PSTR("no_image")); test_end(); return; }
    /* byte roles: U9 must carry word[7:0], U15 word[15:8]. Rows chosen so
       the two bytes differ — a swapped pair of chips cannot pass. */
    static const uint16_t rows_diag[] PROGMEM = {0x0A5, 0x30F, 0xC81};
    static const uint16_t rows_real[] PROGMEM = {0x001, 0x111, 0xFF1};
    bool swapped = true;
    for (uint8_t i = 0; i < 3; i++) {
        uint16_t row = pgm_read_word(
            s_img == IMG_DIAG ? &rows_diag[i] : &rows_real[i]);
        uint16_t want = expected(row);
        uint16_t got = mc_read(row);
        test_check_u16(got & 0xFF, want & 0xFF, PSTR("U9_low_byte"));
        test_check_u16(got >> 8, want >> 8, PSTR("U15_high_byte"));
        if (got != (uint16_t)((want << 8) | (want >> 8))) swapped = false;
    }
    if (swapped)
        uart_putsP("     every row byte-swapped: U9/U15 chips are SWAPPED "
                  "— exchange sockets or re-burn\r\n");
    test_end();
}

void t_microcode_crc(void) {
    test_begin(PSTR("microcode"), PSTR("crc"));
    if (!bind()) { test_end(); return; }
    if (!detect()) { test_check_bool(false, true, PSTR("no_image")); test_end(); return; }
    /* full-ROM verify in-circuit: all 4096 rows, CRC16 PER CHIP so a
       mismatch names the chip to reburn. Constants from microcode_gen.py
       via microcode_expect.h — rig and ROM cannot disagree. */
    uint16_t crc_lo = CRC16_INIT, crc_hi = CRC16_INIT;
    for (uint16_t row = 0; row < 4096; row++) {
        uint16_t w = mc_read(row);
        crc_lo = crc16_update(crc_lo, (uint8_t)(w & 0xFF));
        crc_hi = crc16_update(crc_hi, (uint8_t)(w >> 8));
    }
    uart_putsP("     U9=0x"); uart_puthex16(crc_lo);
    uart_putsP(" U15=0x"); uart_puthex16(crc_hi);
    uart_putsP(" ("); uart_puts_p(img_name_P()); uart_putsP(" burn)\r\n");
    if (s_img == IMG_DIAG) {
        test_check_u16(crc_lo, MC_CRC_U9_DIAG, PSTR("U9_crc"));
        test_check_u16(crc_hi, MC_CRC_U15_DIAG, PSTR("U15_crc"));
    } else {
        test_check_u16(crc_lo, MC_CRC_U9_REAL, PSTR("U9_crc"));
        test_check_u16(crc_hi, MC_CRC_U15_REAL, PSTR("U15_crc"));
    }
    test_end();
}

void t_microcode_taps(void) {
    test_begin(PSTR("microcode"), PSTR("taps"));
    if (!bind()) { test_end(); return; }
    if (!detect()) { test_check_bool(false, true, PSTR("no_image")); test_end(); return; }
    /* strike-7 tap runs: CW9-15 leave this board on their own wires.
       With the rig jumpers at the FAR (consumer) ends per the wiring
       note, drive rows that swing every tap both ways and check each bit
       by name. A tap stuck at one level fails its `..._toggles` check. */
    static const uint16_t rows_diag[] PROGMEM = {0x000, 0xF00, 0xA00, 0x500};
    static const uint16_t rows_real[] PROGMEM =
        {0x000, 0x001, 0x411, 0x471, 0xFF1};
    const uint16_t *rows = s_img == IMG_DIAG ? rows_diag : rows_real;
    uint8_t n = s_img == IMG_DIAG ? 4 : 5;
    uint16_t seen_hi = 0, seen_lo = 0;
    for (uint8_t i = 0; i < n; i++) {
        uint16_t row = pgm_read_word(&rows[i]);
        uint16_t want = expected(row);
        uint16_t got = mc_read(row);
        for (uint8_t b = 9; b < 16; b++)
            if (((got ^ want) >> b) & 1)
                test_check_bool((got >> b) & 1, (want >> b) & 1, PN(CW_NAMES, b));
        seen_hi |= got; seen_lo |= (uint16_t)~got;
    }
    for (uint8_t b = 9; b < 16; b++) {
        bool toggled = ((seen_hi >> b) & 1) && ((seen_lo >> b) & 1);
        test_check_bool(toggled, true, PN(CW_NAMES, b));
    }
    test_end();
}

void t_microcode_stability(void) {
    test_begin(PSTR("microcode"), PSTR("stability"));
    if (!bind()) { test_end(); return; }
    if (!detect()) { test_check_bool(false, true, PSTR("no_image")); test_end(); return; }
    /* edge stress. EEPROMs are static, so ANY flicker here is electrical:
       marginal seating, a floating address line, or supply/ground trouble
       (see the bench ledger for what that smells like). */
    uint16_t bad = 0;
    /* same row, repeated: no flicker */
    for (uint8_t i = 0; i < 64; i++)
        if (mc_read(0x123) != expected(0x123)) bad++;
    test_check_u16(bad, 0, PSTR("repeat_read_flicker"));
    /* adjacent-line coupling: alternate complementary address patterns */
    bad = 0;
    for (uint8_t i = 0; i < 32; i++) {
        if (mc_read(0xAAA) != expected(0xAAA)) bad++;
        if (mc_read(0x555) != expected(0x555)) bad++;
    }
    test_check_u16(bad, 0, PSTR("alternate_AAA_555"));
    /* all address lines slamming together */
    bad = 0;
    for (uint8_t i = 0; i < 32; i++) {
        if (mc_read(0x000) != expected(0x000)) bad++;
        if (mc_read(0xFFF) != expected(0xFFF)) bad++;
    }
    test_check_u16(bad, 0, PSTR("slam_000_FFF"));
    test_end();
}
