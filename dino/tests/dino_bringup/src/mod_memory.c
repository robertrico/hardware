#include <avr/io.h>
#include <util/delay.h>
#include <string.h>
#include "registry.h"
#include "harness.h"
#include "uart.h"
#include "crc16.h"
#include "mem_expect.h"
#include "progrom_expect.h"

/* Memory board: 32K program ROM + 32K RAM + their MDR buffers + the
   write/steering gates. Rig owns the whole address bus.

   Netlist-verified structure (memory.kicad_sch, 2026-07-23):
     U24 AT28C256  ROM: A0-14 = M0-14, ~CE = ROM_EN (=M15, selected LOW
               so the ROM answers 0x0000-0x7FFF), ~OE = ~{ROM_OUT},
               ~WE strapped +5V (write-protected in copper).
     U26 MCM60256AP RAM: A0-14 = M0-14, ~CE = ~{RAM_EN} (selected LOW =
               M15 high = 0x8000-0xFFFF), ~OE = ~{RAM_OUT},
               ~WE = ~{RAM_WRITE_EN}.
     U19 '245  ROM -> MDR, DIR strapped A->B, CE = ~{ROM_OUT}.
     U21 '245  RAM <-> MDR, DIR = ~{WRITE_DIR}, CE = ~{RAM_MDR_EN}.
     U51 '00   all four gates:
               ~{WRITE_DIR}    = INV(WRITE_DIR)
               ~{RAM_WRITE_EN} = NAND(WRITE_DIR, ~{CLK})  <- the write
                     WINDOW. The v0.0.2 '121 one-shot is GONE: the pulse
                     is a gate off the clock phase, nothing to tune.
               RAM_MDR_DIS     = NAND(~{RAM_OUT}, ~{WRITE_DIR})
               ~{RAM_MDR_EN}   = INV(RAM_MDR_DIS)
               i.e. U21 CE = AND(~{RAM_OUT}, ~{WRITE_DIR}) — SCHEMATIC
               BUG 2's fix in copper: the buffer opens for a RAM read or
               a RAM write, never merely because MAR parked on a RAM
               address. `memory.idle` is the test that retires it.

   Expected gate values come from mem_expect.h (host-tested model —
   hosttest/test_mem_expect.c); ROM contents from progrom_expect.h
   (generated by docs/notes/progrom_gen.py, host-tested).

   Two burns, auto-detected from byte 0:
     DIAG (PROG_diag.bin): content-addressed, SELF-NAMING on 0 and every
          2^k — a mis-decoded address line reports the address the chip
          actually saw. Burn FIRST: 15 address lines is the biggest
          one-hole surface on the machine.
     REAL (PROG.bin): the milestone program (adds two numbers).

   PIN LAYOUT (bench-driven, 2026-07-23): both byte buses ride ONE
   unbroken 24-pin run D53 -> D30 — MDR0-7 on D53-D46, M0-M15 on
   D45-D30, each ascending, a ribbon per bus with no controls
   interleaved. Signals follow on D29 -> D22 (U51 in chip pin order)
   plus the D19 spill. Consequence: neither bus is byte-aligned on an
   AVR port any more, so this module drives and samples BOTH PER PIN
   (m_drive/mdr_read/mdr_write below) instead of using the harness's
   fixed-port helpers. The address is static per access — settle()
   dominates, and the 32768-read romcrc sweep still lands well under a
   second.

   Bus discipline: the rig drives MDR only while no board buffer does
   (mem_mdr_driven); it never provokes a fight state (mem_fight).

   Rig-internal probes (in the bundle): ~{WRITE_DIR} (U51.3),
   ~{RAM_WRITE_EN} (U51.6), RAM_MDR_DIS (U51.8), ~{RAM_MDR_EN} (U51.11).

   Driven lines: M0 M1 M2 M3 M4 M5 M6 M7 M8 M9 M10 M11 M12 M13 M14
   M15=ROM_EN ~{RAM_EN} ~{RAM_OUT} ~{ROM_OUT} WRITE_DIR ~{CLK}
   (series R).
   Sampled lines: MDR0 MDR1 MDR2 MDR3 MDR4 MDR5 MDR6 MDR7 (bidir — the
   rig drives them during RAM writes, so series R on those too) + the
   four probes.
   (coverage: every contract signal named). */

static hwpin_t P_IN[MEI_COUNT], P_LOG[MEO_COUNT], P_MDR[8], P_M[16];
static bool s_bound;
static uint8_t s_gen;
static uint16_t s_addr;                 /* M0-14 currently driven */

#define IMG_UNKNOWN 0
#define IMG_DIAG 1
#define IMG_REAL 2
static uint8_t s_img;

/* enum order of mem_expect.h. ROM_EN rides the M bus (it IS M15) and is
   driven by mem_set through m_drive, so it is bound but never driven as
   a lone pin. */
static const char in_names_s0[] PROGMEM = "WRITE_DIR";
static const char in_names_s1[] PROGMEM = "~{CLK}";
static const char in_names_s2[] PROGMEM = "~{RAM_OUT}";
static const char in_names_s3[] PROGMEM = "~{ROM_OUT}";
static const char in_names_s4[] PROGMEM = "M15=ROM_EN";
static const char in_names_s5[] PROGMEM = "~{RAM_EN}";
static const char * const IN_NAMES[MEI_COUNT] PROGMEM = {
    in_names_s0, in_names_s1, in_names_s2,
    in_names_s3, in_names_s4, in_names_s5,
};
static const char log_names_s0[] PROGMEM = "~{WRITE_DIR}";
static const char log_names_s1[] PROGMEM = "~{RAM_WRITE_EN}";
static const char log_names_s2[] PROGMEM = "RAM_MDR_DIS";
static const char log_names_s3[] PROGMEM = "~{RAM_MDR_EN}";
static const char * const LOG_NAMES[MEO_COUNT] PROGMEM = {
    log_names_s0, log_names_s1, log_names_s2, log_names_s3,
};
static const char mdr_names_s0[] PROGMEM = "MDR0";
static const char mdr_names_s1[] PROGMEM = "MDR1";
static const char mdr_names_s2[] PROGMEM = "MDR2";
static const char mdr_names_s3[] PROGMEM = "MDR3";
static const char mdr_names_s4[] PROGMEM = "MDR4";
static const char mdr_names_s5[] PROGMEM = "MDR5";
static const char mdr_names_s6[] PROGMEM = "MDR6";
static const char mdr_names_s7[] PROGMEM = "MDR7";
static const char * const MDR_NAMES[8] PROGMEM = {
    mdr_names_s0, mdr_names_s1, mdr_names_s2, mdr_names_s3,
    mdr_names_s4, mdr_names_s5, mdr_names_s6, mdr_names_s7,
};
static const char m_names_s0[] PROGMEM = "M0";
static const char m_names_s1[] PROGMEM = "M1";
static const char m_names_s2[] PROGMEM = "M2";
static const char m_names_s3[] PROGMEM = "M3";
static const char m_names_s4[] PROGMEM = "M4";
static const char m_names_s5[] PROGMEM = "M5";
static const char m_names_s6[] PROGMEM = "M6";
static const char m_names_s7[] PROGMEM = "M7";
static const char m_names_s8[] PROGMEM = "M8";
static const char m_names_s9[] PROGMEM = "M9";
static const char m_names_s10[] PROGMEM = "M10";
static const char m_names_s11[] PROGMEM = "M11";
static const char m_names_s12[] PROGMEM = "M12";
static const char m_names_s13[] PROGMEM = "M13";
static const char m_names_s14[] PROGMEM = "M14";
static const char m_names_s15[] PROGMEM = "M15=ROM_EN";
static const char * const M_NAMES[16] PROGMEM = {
    m_names_s0, m_names_s1, m_names_s2, m_names_s3, m_names_s4,
    m_names_s5, m_names_s6, m_names_s7, m_names_s8, m_names_s9,
    m_names_s10, m_names_s11, m_names_s12, m_names_s13, m_names_s14,
    m_names_s15,
};

/* ---- per-pin bus access ----
   This module's buses are laid out for the BENCH (one ribbon each,
   D53-D46 = MDR, D45-D30 = M), not for the AVR's port boundaries, so
   neither is byte-aligned and the harness's fixed-port helpers do not
   apply here. Per-pin costs ~10us per access; settle() and the DUT's
   access time dominate anyway. */
static void m_drive(uint16_t a) {
    for (uint8_t i = 0; i < 16; i++) drv(&P_M[i], (a >> i) & 1);
}

static void mdr_write(uint8_t v) {
    for (uint8_t i = 0; i < 8; i++) drv(&P_MDR[i], (v >> i) & 1);
}

static void mdr_release(void) {
    for (uint8_t i = 0; i < 8; i++) rel(&P_MDR[i]);
}

static uint8_t mdr_read(void) {
    mdr_release();
    settle();
    uint8_t v = 0;
    for (uint8_t i = 0; i < 8; i++)
        if (smp(&P_MDR[i])) v |= (uint8_t)(1u << i);
    return v;
}

static bool bind1(const char *sig_P, hwpin_t *out) {
    char sig[24];                       /* sig_lookup wants RAM */
    strcpy_P(sig, sig_P);
    if (sig_lookup("memory", sig, out)) return true;
    uart_putsP("BIND FAIL "); uart_puts(sig); uart_putsP("\r\n");
    test_check_bool(false, true, sig_P);
    return false;
}

static bool bind(void) {
    if (s_bound && s_gen == g_pin_gen) return true;
    s_bound = false;
    s_img = IMG_UNKNOWN;
    bool ok = true;
    for (uint8_t i = 0; i < MEI_COUNT; i++) ok &= bind1(PN(IN_NAMES, i), &P_IN[i]);
    for (uint8_t i = 0; i < MEO_COUNT; i++) ok &= bind1(PN(LOG_NAMES, i), &P_LOG[i]);
    for (uint8_t i = 0; i < 8; i++) ok &= bind1(PN(MDR_NAMES, i), &P_MDR[i]);
    for (uint8_t i = 0; i < 16; i++) ok &= bind1(PN(M_NAMES, i), &P_M[i]);
    if (!ok) return false;                  /* never drive a garbage pin */
    /* ROM_EN IS M15 — one net, one pin. If the pinmap ever splits them
       the address drive and the chip select would disagree silently. */
    if (P_IN[MEI_ROM_EN].port != P_M[15].port ||
        P_IN[MEI_ROM_EN].bit != P_M[15].bit) {
        test_check_bool(false, true, PSTR("ROM_EN_is_M15"));
        return false;
    }
    mdr_release();
    for (uint8_t i = 0; i < MEO_COUNT; i++) rel(&P_LOG[i]);
    s_addr = 0;
    m_drive(0);
    for (uint8_t i = 0; i < MEI_COUNT; i++)
        if (i != MEI_ROM_EN) drv(&P_IN[i], (MEM_IDLE >> i) & 1);
    settle();
    s_bound = true;
    s_gen = g_pin_gen;
    return true;
}

/* Drive the whole board state: M0-14 from s_addr, M15 from the word's
   ROM_EN bit (they share the bus), the rest as lone pins. */
static void mem_set(uint8_t in) {
    uint16_t mbus = (uint16_t)(s_addr & 0x7FFF);
    if ((in >> MEI_ROM_EN) & 1) mbus |= 0x8000;
    m_drive(mbus);
    for (uint8_t i = 0; i < MEI_COUNT; i++)
        if (i != MEI_ROM_EN) drv(&P_IN[i], (in >> i) & 1);
    settle();
}

static uint8_t log_sample(void) {
    uint8_t v = 0;
    for (uint8_t i = 0; i < MEO_COUNT; i++)
        if (smp(&P_LOG[i])) v |= (uint8_t)(1u << i);
    return v;
}

#define NO_BIT(b) ((uint8_t)~(1u << (b)))

/* quiescent control word for an address: strobes idle, chip selects as
   the MAR board would drive them (ROM_EN = M15, ~RAM_EN = INV(M15)) */
static uint8_t idle_for(uint16_t addr) {
    uint8_t v = (uint8_t)((1u << MEI_RAM_OUT_N) | (1u << MEI_ROM_OUT_N));
    if (addr & 0x8000) v |= 1u << MEI_ROM_EN;      /* RAM half: ROM off  */
    else               v |= 1u << MEI_RAM_EN_N;    /* ROM half: RAM off  */
    return v;
}

static uint8_t rom_read(uint16_t addr) {
    s_addr = addr;
    uint8_t base = idle_for(addr);
    mem_set(base & NO_BIT(MEI_ROM_OUT_N));
    uint8_t v = mdr_read();
    mem_set(base);
    return v;
}

static uint8_t ram_read(uint16_t addr) {
    s_addr = addr;
    uint8_t base = idle_for(addr);
    mem_set(base & NO_BIT(MEI_RAM_OUT_N));
    uint8_t v = mdr_read();
    mem_set(base);
    return v;
}

/* RAM write: rig supplies the byte on MDR, WRITE_DIR flips U21 to
   MDR->RAM, then ~CLK high opens the ~WE window (U51 gate 2). */
static void ram_write(uint16_t addr, uint8_t v) {
    s_addr = addr;
    uint8_t base = idle_for(addr) | (1u << MEI_WRITE_DIR);
    mdr_write(v);
    mem_set(base);                              /* buffer turns, ~WE high */
    mem_set(base | (1u << MEI_CLK_N));          /* window OPEN            */
    mem_set(base);                              /* window closed, latched */
    mem_set(idle_for(addr));
    mdr_release(); settle();
}

/* byte-0 signature -> image type; prints what it saw */
static bool detect(void) {
    if (s_img != IMG_UNKNOWN) return true;
    uint8_t b = rom_read(0);
    if (b == PR_DIAG_BYTE0) s_img = IMG_DIAG;
    else if (b == PR_REAL_BYTE0) s_img = IMG_REAL;
    uart_putsP("     image: ");
    uart_puts_p(s_img == IMG_DIAG ? PSTR("DIAG")
                : s_img == IMG_REAL ? PSTR("REAL") : PSTR("?"));
    uart_putsP(" (byte0=0x"); uart_puthex8(b); uart_putsP(")\r\n");
    return s_img != IMG_UNKNOWN;
}

static uint8_t rom_expected(uint16_t addr) {
    if (s_img == IMG_DIAG) return pr_diag_byte(addr);
    return addr < PR_PROGRAM_LEN ? pgm_read_byte(&PR_PROGRAM[addr])
                                 : (uint8_t)PR_SAFE_FILL;
}

/* A diag value from the witness set names the address the chip ACTUALLY
   decoded — so a swapped or stuck address line reports itself. */
static void name_witness(uint8_t v) {
    if (v == PR_DIAG_ZERO) { uart_putsP(" -> chip decoded 0x0000"); return; }
    if ((v & 0xF0u) == PR_DIAG_WALK && (v & 0x0Fu) < 15) {
        uart_putsP(" -> chip decoded 0x");
        uart_puthex16((uint16_t)1 << (v & 0x0Fu));
        return;
    }
    uart_putsP(" -> not a witness value (data fault, not address)");
}

void t_memory_power(void) {
    test_begin(PSTR("memory"), PSTR("power"));
    if (!bind()) { test_end(); return; }
    /* PHANTOM-POWER CHECK — runs first, and every module should have
       one (bench, 2026-07-23: an UNPOWERED board scored 7/10 because
       the rig's driven lines push current through the DUT's input
       clamp diodes into its VCC rail; CMOS memory reads fine on stolen
       current, so only the bipolar '00 and the write cycles failed).

       The trick: hold EVERY rig output low except ~{ROM_OUT} (which
       stays high only to keep U19 and U21 off MDR at once — a single
       current source, the minimum this board allows). With no current
       to steal, an unpowered '00 cannot pull anything up, so its three
       HIGH outputs collapse. A powered one holds them. */
    uint8_t in = (uint8_t)(1u << MEI_ROM_OUT_N);
    s_addr = 0;
    mdr_release();
    mem_set(in);
    _delay_ms(2);                       /* let stolen charge drain */
    uint8_t got = log_sample(), want = mem_expect(in);
    if (got != want) {
        uart_putsP("     DUT looks UNPOWERED (or U51 has no VCC/GND):"
                   " with the rig sourcing nothing, these must hold\r\n");
        for (uint8_t i = 0; i < MEO_COUNT; i++)
            if (((got ^ want) >> i) & 1) {
                uart_putsP("       "); uart_puts_p(PN(LOG_NAMES, i));
                uart_puts_p(((want >> i) & 1) ? PSTR(" want 1, reads 0\r\n")
                                              : PSTR(" want 0, reads 1\r\n"));
            }
        uart_putsP("     check bench 5V and the board's rail before"
                   " reading any other FAIL in this run\r\n");
    }
    for (uint8_t i = 0; i < MEO_COUNT; i++)
        if (((got ^ want) >> i) & 1)
            test_check_bool((got >> i) & 1, (want >> i) & 1, PN(LOG_NAMES, i));
    mem_set(idle_for(0));
    test_end();
}

void t_memory_warmup(void) {
    test_begin(PSTR("memory"), PSTR("warmup"));
    if (!bind()) { test_end(); return; }
    /* readiness probe (same bench lesson as pc/microcode/mdr): a ROM
       signature read plus a RAM round trip until it holds 4x. 0xC5 is a
       non-palindrome (mirror-witness rule). */
    uint16_t waited_ms = 0;
    uint8_t streak = 0;
    while (streak < 4 && waited_ms < 10000) {
        s_img = IMG_UNKNOWN;
        uint8_t b = rom_read(0);
        bool ok = (b == PR_DIAG_BYTE0 || b == PR_REAL_BYTE0);
        ram_write(0x8000, 0xC5); ok &= (ram_read(0x8000) == 0xC5);
        ram_write(0x8000, 0x3A); ok &= (ram_read(0x8000) == 0x3A);
        if (ok) {
            streak++;
        } else {
            streak = 0;
            _delay_ms(100);
            waited_ms += 100;
        }
    }
    uart_putsP("     ready after ~");
    uart_putdec(waited_ms);
    uart_putsP("ms of settle\r\n");
    test_check_bool(streak == 4, true, PSTR("board_ready_within_10s"));
    (void)detect();
    test_end();
}

void t_memory_presence(void) {
    test_begin(PSTR("memory"), PSTR("presence"));
    if (!bind()) { test_end(); return; }
    /* U51's four outputs are totem-pole — always driven. A float names a
       missing chip or a dead jumper. */
    mem_set(idle_for(0));
    for (uint8_t i = 0; i < MEO_COUNT; i++)
        test_check_bool(!floats(&P_LOG[i]), true, PN(LOG_NAMES, i));
    /* during a ROM read U19 must drive every MDR line */
    s_addr = 0;
    mem_set(idle_for(0) & NO_BIT(MEI_ROM_OUT_N));
    for (uint8_t i = 0; i < 8; i++)
        test_check_bool(!floats(&P_MDR[i]), true, PN(MDR_NAMES, i));
    mem_set(idle_for(0));
    test_check_bool(detect(), true, PSTR("byte0_signature_known"));
    test_end();
}

void t_memory_logic(void) {
    test_begin(PSTR("memory"), PSTR("logic"));
    if (!bind()) { test_end(); return; }
    /* U51 truth, exhaustive: all 64 control states vs the host-tested
       model. Fight states (two drivers on MDR, or U21 pushing into a
       RAM that is driving its own DQ) are skipped and counted. */
    uint16_t bad = 0, skipped = 0;
    s_addr = 0x1234;
    for (uint8_t in = 0; in < (1u << MEI_COUNT); in++) {
        if (mem_fight(in)) { skipped++; continue; }
        mem_set(in);
        uint8_t got = log_sample(), want = mem_expect(in);
        if (got == want) continue;
        bad++;
        if (bad <= 8) {
            uart_putsP("     in=0x"); uart_puthex8(in);
            for (uint8_t i = 0; i < MEO_COUNT; i++)
                if (((got ^ want) >> i) & 1) {
                    uart_putc(' '); uart_puts_p(PN(LOG_NAMES, i));
                    uart_puts_p(((want >> i) & 1) ? PSTR("(want 1)")
                                                  : PSTR("(want 0)"));
                }
            uart_putsP("\r\n");
        }
    }
    if (bad > 8) uart_putsP("     ... further mismatches suppressed\r\n");
    uart_putsP("     skipped ");
    uart_putdec(skipped);
    uart_putsP(" bus-fight states (by design)\r\n");
    mem_set(idle_for(0));
    test_check_u16(bad, 0, PSTR("logic_mismatch_states"));
    test_end();
}

void t_memory_romorder(void) {
    test_begin(PSTR("memory"), PSTR("romorder"));
    if (!bind()) { test_end(); return; }
    if (!detect()) { test_check_bool(false, true, PSTR("no_image")); test_end(); return; }
    if (s_img == IMG_DIAG) {
        /* walking-1 through all 15 ROM address lines. The diag value
           names the row the chip actually decoded, so a swapped or
           stuck line prints where it landed. */
        bool ok = true;
        test_check_u16(rom_read(0), PR_DIAG_ZERO, PSTR("addr_0x0000"));
        for (uint8_t k = 0; k < 15; k++) {
            uint16_t a = (uint16_t)1 << k;
            uint8_t got = rom_read(a), want = pr_diag_byte(a);
            if (got == want) continue;
            ok = false;
            uart_putsP("     drove "); uart_puts_p(PN(M_NAMES, k));
            uart_putsP(" (0x"); uart_puthex16(a);
            uart_putsP("): got 0x"); uart_puthex8(got);
            name_witness(got);
            uart_putsP("\r\n");
        }
        test_check_bool(ok, true, PSTR("walking1_address_lines"));
        test_check_u16(rom_read(0x7FFF), pr_diag_byte(0x7FFF), PSTR("all_high"));
    } else {
        /* REAL burn: most rows are safe-fill, so line order is only
           spot-checkable here — the DIAG burn is the real proof. */
        uart_putsP("     REAL burn: program-row spot check only; "
                   "full address proof needs the DIAG burn\r\n");
        for (uint16_t a = 0; a < PR_PROGRAM_LEN; a++)
            test_check_u16(rom_read(a), rom_expected(a), PSTR("program_byte"));
        test_check_u16(rom_read(PR_PROGRAM_LEN), PR_SAFE_FILL, PSTR("safe_fill"));
    }
    test_end();
}

void t_memory_romcrc(void) {
    test_begin(PSTR("memory"), PSTR("romcrc"));
    if (!bind()) { test_end(); return; }
    if (!detect()) { test_check_bool(false, true, PSTR("no_image")); test_end(); return; }
    /* full-ROM verify in-circuit: all 32768 bytes, CRC16 against the
       generator's constant (progrom_gen.py prints the same numbers) */
    uint16_t crc = CRC16_INIT;
    uint8_t base = idle_for(0) & NO_BIT(MEI_ROM_OUT_N);
    for (uint16_t a = 0; a < 0x8000; a++) {
        s_addr = a;
        mem_set(base);
        crc = crc16_update(crc, mdr_read());
    }
    mem_set(idle_for(0));
    uart_putsP("     ROM crc=0x"); uart_puthex16(crc); uart_putsP("\r\n");
    test_check_u16(crc, s_img == IMG_DIAG ? PR_CRC_DIAG : PR_CRC_REAL,
                   PSTR("rom_crc"));
    test_end();
}

void t_memory_ramrw(void) {
    test_begin(PSTR("memory"), PSTR("ramrw"));
    if (!bind()) { test_end(); return; }
    /* per-bit data walk at the RAM base */
    for (uint8_t b = 0; b < 8; b++) {
        ram_write(0x8000, (uint8_t)(1u << b));
        test_check_u16(ram_read(0x8000), (uint8_t)(1u << b), PSTR("data_walk1"));
        ram_write(0x8000, (uint8_t)~(1u << b));
        test_check_u16(ram_read(0x8000), (uint8_t)~(1u << b), PSTR("data_walk0"));
    }
    /* address-line walk: a distinct byte per line, written first and
       read back after — proves all 15 RAM address lines independently
       of which ROM image happens to be burned (mirror witness) */
    ram_write(0x8000, 0xA5);
    for (uint8_t k = 0; k < 15; k++)
        ram_write((uint16_t)(0x8000 | (1u << k)), (uint8_t)(0x40 | k));
    test_check_u16(ram_read(0x8000), 0xA5, PSTR("addr_base_holds"));
    for (uint8_t k = 0; k < 15; k++) {
        uint16_t a = (uint16_t)(0x8000 | (1u << k));
        uint8_t got = ram_read(a);
        if (got == (uint8_t)(0x40 | k)) continue;
        uart_putsP("     drove "); uart_puts_p(PN(M_NAMES, k));
        uart_putsP(" (0x"); uart_puthex16(a);
        uart_putsP("): got 0x"); uart_puthex8(got);
        if ((got & 0xF0u) == 0x40u && (got & 0x0Fu) < 15) {
            uart_putsP(" -> cell of 0x");
            uart_puthex16((uint16_t)(0x8000 | (1u << (got & 0x0Fu))));
        }
        uart_putsP("\r\n");
        test_check_u16(got, (uint8_t)(0x40 | k), PSTR("addr_walk"));
    }
    /* far corners keep their own bytes (no aliasing) */
    ram_write(0xFFFF, 0x3C);
    ram_write(0xC000, 0xC3);
    test_check_u16(ram_read(0xFFFF), 0x3C, PSTR("top_of_RAM"));
    test_check_u16(ram_read(0xC000), 0xC3, PSTR("mid_of_RAM"));
    test_check_u16(ram_read(0x8000), 0xA5, PSTR("base_still_holds"));
    test_end();
}

void t_memory_select(void) {
    test_begin(PSTR("memory"), PSTR("select"));
    if (!bind()) { test_end(); return; }
    if (!detect()) { test_check_bool(false, true, PSTR("no_image")); test_end(); return; }
    /* the 0x8000 boundary is exact: 0x7FFF is ROM, 0x8000 is RAM, and
       each chip stays off the bus in the other's half */
    ram_write(0x8000, 0x5A);
    test_check_u16(rom_read(0x7FFF), rom_expected(0x7FFF), PSTR("ROM_at_0x7FFF"));
    test_check_u16(ram_read(0x8000), 0x5A, PSTR("RAM_at_0x8000"));
    /* ROM strobe in the RAM half: the ROM chip is deselected, so U19
       must not deliver ROM data (the RAM's byte must not appear either
       — nothing legitimate drives MDR here) */
    s_addr = 0x8000;
    mem_set(idle_for(0x8000) & NO_BIT(MEI_ROM_OUT_N));
    uint8_t stray = mdr_read();
    mem_set(idle_for(0x8000));
    test_check_bool(stray == 0x5A, false, PSTR("ROM_strobe_leaks_RAM_data"));
    /* RAM strobe in the ROM half: RAM deselected, ROM data must not
       reach MDR through U21 */
    s_addr = 0x7FFF;
    mem_set(idle_for(0x7FFF) & NO_BIT(MEI_RAM_OUT_N));
    stray = mdr_read();
    mem_set(idle_for(0x7FFF));
    test_check_bool(stray == rom_expected(0x7FFF), false,
                    PSTR("RAM_strobe_leaks_ROM_data"));
    test_end();
}

void t_memory_window(void) {
    test_begin(PSTR("memory"), PSTR("window"));
    if (!bind()) { test_end(); return; }
    /* write.window: ~{RAM_WRITE_EN} = NAND(WRITE_DIR, ~{CLK}). A write
       must land ONLY inside that window — this is what replaced the
       v0.0.2 '121 one-shot, so it gets the sharpest test on the board. */
    ram_write(0xA000, 0x11);
    /* attempt 1: WRITE_DIR asserted but ~CLK low the whole time */
    s_addr = 0xA000;
    uint8_t base = idle_for(0xA000) | (1u << MEI_WRITE_DIR);
    mdr_write(0xEE);
    mem_set(base);
    test_check_bool(smp(&P_LOG[MEO_RAM_WRITE_EN_N]), true,
                    PSTR("~{RAM_WRITE_EN}"));
    mem_set(idle_for(0xA000));
    mdr_release(); settle();
    test_check_u16(ram_read(0xA000), 0x11, PSTR("no_write_when_CLK_high"));
    /* attempt 2: ~CLK high but WRITE_DIR idle */
    mdr_write(0xEE);
    s_addr = 0xA000;
    mem_set(idle_for(0xA000) | (1u << MEI_CLK_N));
    test_check_bool(smp(&P_LOG[MEO_RAM_WRITE_EN_N]), true,
                    PSTR("~{RAM_WRITE_EN}"));
    mem_set(idle_for(0xA000));
    mdr_release(); settle();
    test_check_u16(ram_read(0xA000), 0x11, PSTR("no_write_without_WRITE_DIR"));
    /* both together: the window opens and the byte lands */
    s_addr = 0xA000;
    mem_set(idle_for(0xA000) | (1u << MEI_WRITE_DIR) | (1u << MEI_CLK_N));
    test_check_bool(smp(&P_LOG[MEO_RAM_WRITE_EN_N]), false,
                    PSTR("~{RAM_WRITE_EN}"));
    mem_set(idle_for(0xA000));
    ram_write(0xA000, 0x22);
    test_check_u16(ram_read(0xA000), 0x22, PSTR("write_lands_in_window"));
    test_end();
}

void t_memory_idle(void) {
    test_begin(PSTR("memory"), PSTR("idle"));
    if (!bind()) { test_end(); return; }
    /* THE BUG-2 RETIREMENT TEST. MAR parked on a RAM address, no RAM op
       in flight (~RAM_OUT high, WRITE_DIR low): U21's CE = AND(~RAM_OUT,
       ~WRITE_DIR) must hold the buffer OFF, so MDR floats. On the
       pre-review schematic U21 was enabled by ~RAM_EN alone and buffered
       floating RAM DQ onto MDR against legitimate register drivers —
       inside ordinary instructions (any ALU T-state after a RAM operand
       fetch). */
    s_addr = 0xBEEF;
    mem_set(idle_for(0xBEEF));
    test_check_bool(smp(&P_LOG[MEO_RAM_MDR_EN_N]), true, PSTR("~{RAM_MDR_EN}"));
    for (uint8_t i = 0; i < 8; i++)
        test_check_bool(floats(&P_MDR[i]), true, PN(MDR_NAMES, i));
    /* same in the ROM half with the ROM strobe idle */
    s_addr = 0x1000;
    mem_set(idle_for(0x1000));
    for (uint8_t i = 0; i < 8; i++)
        test_check_bool(floats(&P_MDR[i]), true, PN(MDR_NAMES, i));
    test_end();
}

void t_memory_stability(void) {
    test_begin(PSTR("memory"), PSTR("stability"));
    if (!bind()) { test_end(); return; }
    if (!detect()) { test_check_bool(false, true, PSTR("no_image")); test_end(); return; }
    /* edge stress. ROM and RAM are static — any flicker is electrical
       (seating, address-line coupling, supply/ground — bench ledger). */
    uint16_t bad = 0;
    for (uint8_t i = 0; i < 32; i++)
        if (rom_read(0x1234) != rom_expected(0x1234)) bad++;
    test_check_u16(bad, 0, PSTR("rom_repeat_flicker"));
    bad = 0;
    for (uint8_t i = 0; i < 16; i++) {      /* adjacent-line coupling */
        if (rom_read(0x2AAA) != rom_expected(0x2AAA)) bad++;
        if (rom_read(0x5555) != rom_expected(0x5555)) bad++;
    }
    test_check_u16(bad, 0, PSTR("rom_alternate_2AAA_5555"));
    bad = 0;
    for (uint8_t i = 0; i < 16; i++) {      /* all address lines slamming */
        if (rom_read(0x0000) != rom_expected(0x0000)) bad++;
        if (rom_read(0x7FFF) != rom_expected(0x7FFF)) bad++;
    }
    test_check_u16(bad, 0, PSTR("rom_slam_0000_7FFF"));
    bad = 0;
    for (uint8_t i = 0; i < 16; i++) {      /* RAM write/read slam */
        ram_write(0x9555, 0xC5);
        if (ram_read(0x9555) != 0xC5) bad++;
        ram_write(0x9555, 0x3A);
        if (ram_read(0x9555) != 0x3A) bad++;
    }
    test_check_u16(bad, 0, PSTR("ram_write_read_slam"));
    test_end();
}
